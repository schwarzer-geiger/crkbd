/*
 * Copyright (c) 2020 The ZMK Contributors
 *
 * SPDX-License-Identifier: MIT
 */
&spi1 {
	compatible = "nordic,nrf-spi";
	/* Cannot be used together with i2c0. */
	status = "okay";
	mosi-pin = <9>;
	// Unused pins, needed for SPI definition, but not used by the ws2812 driver itself.
	sck-pin = <43>;
	miso-pin = <10>;

	led_strip: ws2812@0 {
		compatible = "worldsemi,ws2812-spi";
		label = "ws2812";

		/* SPI */
		reg = <0>; /* ignored, but necessary for SPI bindings */
		spi-max-frequency = <4000000>;

		/* WS2812 */
		chain-length = <10>; /* There are per-key RGB, but the first 6 are underglow */
		spi-one-frame = <0x70>;
		spi-zero-frame = <0x40>;
	};
};

/ {
	chosen {
		zmk,underglow = &led_strip;
	};
};
