/*
 * Copyright (c) 2020 Pete Johanson
 *
 * SPDX-License-Identifier: MIT
 */



left_encoder: encoder_left {
        compatible = "alps,ec11";
        label = "LEFT_ENCODER";
        a-gpios = <B5 (GPIO_ACTIVE_HIGH | GPIO_PULL_UP)>;
        b-gpios = <B6 (GPIO_ACTIVE_HIGH | GPIO_PULL_UP)>;
        resolution = <4>;
    };

sensors {
        compatible = "zmk,keymap-sensors";
        sensors = <&left_encoder>;
    };
